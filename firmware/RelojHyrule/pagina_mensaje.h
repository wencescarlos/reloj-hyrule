// ===========================================================================
//  pagina_mensaje.h  -  Página del móvil para mandar mensajes (/mensaje)
//  Reloj de Hyrule · Proyecto de fans SIN ÁNIMO DE LUCRO · No oficial
//  CC BY-NC-SA 4.0 · https://github.com/wencescarlos/reloj-hyrule
//  ARCHIVO GENERADO por firmware/herramientas/pagina_mensaje/generar.py
//  a partir de mensaje.html, fuente.h y sprites.h. No lo edites a mano.
// ===========================================================================
#pragma once
#include <Arduino.h>

const char PAGINA_MENSAJE[] PROGMEM = R"PAGINA(<!DOCTYPE html>
<html lang="es"><head><meta charset="utf-8">
<meta name="viewport" content="width=device-width,initial-scale=1,viewport-fit=cover">
<meta name="apple-mobile-web-app-capable" content="yes">
<meta name="mobile-web-app-capable" content="yes">
<meta name="apple-mobile-web-app-status-bar-style" content="black-translucent">
<meta name="apple-mobile-web-app-title" content="Hyrule">
<meta name="theme-color" content="#0f2418">
<link rel="apple-touch-icon" href="/apple-touch-icon.png">
<link rel="icon" type="image/png" href="/icono.png">
<link rel="manifest" href="/manifest.json">
<title>Mensaje · Reloj de Hyrule</title>
<style>
:root{--fondo:#0f2418;--tarjeta:#173323;--borde:#c9a227;--oro:#e8c04a;--texto:#f3ecd2;--suave:#b8c4a8;--rojo:#ff6b4a}
*{box-sizing:border-box;-webkit-tap-highlight-color:transparent}
html,body{margin:0;background:var(--fondo);color:var(--texto)}
body{font:16px/1.4 Georgia,"Times New Roman",serif;padding:calc(env(safe-area-inset-top) + 12px) 14px calc(env(safe-area-inset-bottom) + 110px);
 background:var(--fondo) radial-gradient(circle at 50% -10%,#2a5a3c 0,transparent 55%) no-repeat}
main{max-width:560px;margin:0 auto}
header{display:flex;align-items:center;gap:10px;margin-bottom:10px}
header svg{width:34px;height:30px;flex:none;filter:drop-shadow(0 0 6px #e8c04a88)}
h1{font-size:1.25em;margin:0;color:var(--oro);letter-spacing:.03em;line-height:1.1}
#estado{margin-left:auto;font-size:.78em;color:var(--suave);text-align:right}
#estado b{display:inline-block;width:9px;height:9px;border-radius:50%;background:#777;margin-right:5px;vertical-align:middle}
#estado.ok b{background:#5fd35f;box-shadow:0 0 6px #5fd35f}
.matriz{background:#070d09;border:2px solid var(--borde);border-radius:12px;padding:10px 8px;box-shadow:0 0 0 4px #0b1a11 inset}
canvas{display:block;width:100%;image-rendering:pixelated}
.tiempo{font-size:.8em;color:var(--suave);text-align:center;margin-top:6px}
section{background:var(--tarjeta);border:2px solid #2f5a3f;border-radius:14px;padding:12px;margin:12px 0}
h2{font-size:1em;margin:0 0 8px;color:var(--oro);display:flex;align-items:center;gap:7px}
h2:before{content:"";border-left:6px solid transparent;border-right:6px solid transparent;border-bottom:10px solid var(--oro)}
textarea{width:100%;min-height:76px;resize:vertical;padding:10px;border-radius:10px;border:1px solid #5d7a4f;background:#0d1d13;color:var(--texto);
 font:700 18px/1.3 "Courier New",monospace;text-transform:uppercase}
textarea:focus{outline:2px solid var(--oro)}
.pie{display:flex;justify-content:space-between;align-items:center;font-size:.8em;color:var(--suave);margin-top:4px}
.chips{display:flex;gap:6px;overflow-x:auto;padding:2px 0 4px;scrollbar-width:none}
.chips::-webkit-scrollbar{display:none}
.chip{flex:none;border:1px solid #5d7a4f;background:#0d1d13;color:var(--texto);border-radius:20px;padding:7px 12px;font:14px Georgia,serif}
.chip.sel{border-color:var(--oro);color:#1d1606;background:var(--oro);font-weight:700}
.chips.envolver{flex-wrap:wrap;overflow:visible}
#secConc.activo{border-color:var(--oro);box-shadow:0 0 12px #e8c04a44}
.chip.quitar{border-color:var(--rojo);color:#ffd7d4;background:#5a1d1b}
.peque{padding:5px 10px;font-size:13px}
.personajes{display:grid;grid-template-columns:repeat(4,1fr);gap:7px}
.pj{border:2px solid #2f5a3f;background:#0d1d13;border-radius:12px;padding:7px 4px 6px;text-align:center;color:var(--texto);font:12.5px Georgia,serif}
.pj canvas{width:100%;height:auto;margin-bottom:4px;border-radius:6px;background:#070d09}
.pj.sel{border-color:var(--oro);box-shadow:0 0 10px #e8c04a55;color:var(--oro);font-weight:700}
select{width:100%;margin-top:8px;padding:9px;border-radius:10px;border:1px solid #5d7a4f;background:#0d1d13;color:var(--texto);font:15px Georgia,serif}
.barra{position:fixed;left:0;right:0;bottom:0;padding:10px 14px calc(env(safe-area-inset-bottom) + 10px);
 background:linear-gradient(transparent,#0f2418 30%);display:flex;gap:8px;justify-content:center}
.barra>div{display:flex;gap:8px;width:100%;max-width:560px}
.enviar{flex:1;border:0;border-radius:14px;padding:15px;font:700 18px Georgia,serif;color:#1d1606;background:linear-gradient(#f0cd5c,#b38a1b);
 box-shadow:0 4px 14px #0008}
.enviar:active{transform:scale(.98)}
.parar{display:none;border:1px solid var(--rojo);border-radius:14px;padding:15px 16px;font:700 16px Georgia,serif;color:#ffd7d4;background:#5a1d1b}
.parar.ver{display:block}
#aviso{position:fixed;left:50%;top:calc(env(safe-area-inset-top) + 12px);transform:translateX(-50%);background:var(--oro);color:#1d1606;
 padding:10px 18px;border-radius:30px;font-weight:700;opacity:0;transition:.3s;pointer-events:none;z-index:9;white-space:nowrap}
#aviso.ver{opacity:1}
.enlace{display:block;text-align:center;color:var(--suave);font-size:.85em;margin:16px 0 0}
.consejo{font-size:.8em;color:var(--suave);margin:8px 0 0}
</style></head><body><main>
<header>
 <svg viewBox="0 0 64 56" aria-hidden="true"><g fill="#e8c04a"><polygon points="32,0 48,28 16,28"/><polygon points="16,28 32,56 0,56"/><polygon points="48,28 64,56 32,56"/></g></svg>
 <h1 id="titulo">Mensaje para el héroe</h1>
 <div id="estado"><b></b><span id="estadoTxt">Buscando el reloj...</span></div>
</header>

<div class="matriz"><canvas id="vista" width="320" height="80"></canvas></div>
<div class="tiempo" id="tiempo"></div>

<section>
 <h2 id="tMensaje">Tu mensaje</h2>
 <textarea id="texto" maxlength="200" placeholder="¡A CENAR, {N}!" autocapitalize="characters" autocomplete="off" enterkeyhint="send"></textarea>
 <div class="pie"><button type="button" class="chip peque" id="bNombre">+ nombre</button><span id="cuenta">0/200</span></div>
 <div class="chips" id="rapidos" style="margin-top:8px"></div>
</section>

<section>
 <h2 id="tPersonaje">¿Quién lo trae?</h2>
 <div class="personajes" id="personajes"></div>
 <select id="aventura"></select>
</section>

<section>
 <h2 id="tDuracion">¿Cuánto tiempo en pantalla?</h2>
 <div class="chips envolver" id="duraciones"></div>
 <h2 id="tVelocidad" style="margin-top:12px">Velocidad</h2>
 <div class="chips envolver" id="velocidades"></div>
 <p class="consejo" id="consejo">Para quien está aprendiendo a leer: despacio y 1 minuto o más.</p>
</section>

<section>
 <h2 id="tSonido">Sonido del aviso</h2>
 <div class="chips envolver" id="sonidos"></div>
 <button type="button" class="chip peque" id="probarSonido" style="margin-top:6px">♪ Probar en el reloj</button>
 <p class="consejo" id="sinZumbador" style="display:none">El reloj no tiene zumbador activado (Ajustes del reloj → Sonido).</p>
</section>

<section id="secConc">
 <h2 id="tConc">Modo concentración</h2>
 <p class="consejo" id="concTexto" style="margin-top:0">Solo la hora, quieta: sin segundos, sin fecha y sin aventuras.</p>
 <div class="chips envolver" id="concBotones"></div>
 <p class="consejo"><b id="concEstado"></b></p>
</section>

<a class="enlace" href="/" id="aAjustes">⚙️ Ajustes del reloj</a>
</main>

<div class="barra"><div>
 <button type="button" class="parar" id="parar">■</button>
 <button type="button" class="enviar" id="enviar">Enviar al reloj ▲</button>
</div></div>
<div id="aviso"></div>

<script>
// ---- Datos generados a partir del firmware (fuente y dibujos del reloj) ----
const FUENTE={"1":[24,60,120,60,24],"2":[56,124,198,124,56],"3":[32,48,36,6,36,48,32],"4":[34,20,8,20,34],"32":[0,0,0],"33":[190],"34":[6,0,6],"35":[36,126,36,126,36],"37":[70,38,16,200,196],"38":[108,146,170,68,160],"39":[6],"40":[124,130],"41":[130,124],"42":[84,56,124,56,84],"43":[16,16,124,16,16],"44":[128,64],"45":[16,16,16,16],"46":[128],"47":[128,96,16,12,2],"48":[124,130,130,130,124],"49":[0,132,254,128,0],"50":[132,194,162,146,140],"51":[66,130,138,150,98],"52":[48,40,36,254,32],"53":[78,138,138,138,114],"54":[120,148,146,146,96],"55":[2,226,18,10,6],"56":[108,146,146,146,108],"57":[12,146,146,82,60],"58":[108],"59":[128,108],"60":[16,40,68,130],"61":[40,40,40,40],"62":[130,68,40,16],"63":[4,2,162,18,12],"64":[124,130,186,170,60],"65":[252,18,18,18,252],"66":[254,146,146,146,108],"67":[124,130,130,130,68],"68":[254,130,130,130,124],"69":[254,146,146,146,130],"70":[254,18,18,18,2],"71":[124,130,146,146,244],"72":[254,16,16,16,254],"73":[130,254,130],"74":[64,128,130,126,2],"75":[254,16,40,68,130],"76":[254,128,128,128,128],"77":[254,4,24,4,254],"78":[254,8,16,32,254],"79":[124,130,130,130,124],"80":[254,18,18,18,12],"81":[124,130,162,66,188],"82":[254,18,50,82,140],"83":[140,146,146,146,98],"84":[2,2,254,2,2],"85":[126,128,128,128,126],"86":[62,64,128,64,62],"87":[126,128,112,128,126],"88":[198,40,16,40,198],"89":[6,8,240,8,6],"90":[194,162,146,138,134],"91":[254,130],"93":[130,254],"95":[128,128,128,128],"128":[252,18,19,18,252],"129":[254,146,147,146,130],"130":[130,255,130],"131":[124,130,131,130,124],"132":[126,128,129,128,126],"133":[126,129,128,129,126],"134":[254,9,17,33,255],"135":[250],"136":[96,144,138,128,64],"137":[14,10,14]};
const SPR={"HEROE_TESORO":[3,172,118,62,118,172,3,0],"HADA_A":[27,10,4,10,27],"COFRE_ABIERTO":[123,73,73,89,89,89,73,73,123],"CORAZON":[6,15,31,62,31,15,6],"TRIANGULO":[8,12,14,15,14,12,8],"BOMBA":[112,216,236,252,252,250,113]};
// ---------------------------------------------------------------------------
const $=s=>document.querySelector(s);
let L="es",NOMBRE="",conectado=false;
const t=(es,en)=>L==="en"?en:es;
const guardado=(()=>{try{return JSON.parse(localStorage.getItem("hyrule-msg")||"{}")}catch(e){return{}}})();
function guardar(){try{localStorage.setItem("hyrule-msg",JSON.stringify(est))}catch(e){}}
const est=Object.assign({pj:"1",dur:60,vel:80,son:0,recientes:[]},guardado);
let MELODIAS=[],HAY_SONIDO=false;

const PERSONAJES=[["0","Solo texto","Just text"],["1","Héroe","Hero"],["2","Hada","Fairy"],["3","Cofre","Chest"],
 ["4","Corazones","Hearts"],["5","Trifuerza","Triforce"],["6","Bomba","Bomb"],["s","Sorpresa","Surprise"]];
const DURACIONES=[[0,"1 vez","Once"],[30,"30 s","30 s"],[60,"1 min","1 min"],[120,"2 min","2 min"],[300,"5 min","5 min"],[600,"10 min","10 min"]];
const VELOCIDADES=[[80,"🐢 Despacio","🐢 Slow"],[50,"Normal","Normal"],[30,"🐇 Rápido","🐇 Fast"]];
const RAPIDOS={es:["¡A CENAR, {N}!","¡A DORMIR, {N}!","¡TE QUIERO, {N}! ♥","¡LÁVATE LOS DIENTES!","¡A LA DUCHA!","¡VAMOS AL COLE!","¡A RECOGER!","¡ERES UN HÉROE! ▲"],
 en:["DINNER TIME, {N}!","BEDTIME, {N}!","I LOVE YOU, {N}! ♥","BRUSH YOUR TEETH!","SHOWER TIME!","TIME FOR SCHOOL!","TIDY UP TIME!","YOU ARE A HERO! ▲"]};

// ---- Dibujo en la "matriz" del móvil ----
function codigos(s){
 const out=[];for(const ch of s){let c=ch.codePointAt(0);
  if(c>=97&&c<=122)c-=32;
  else if(c>127){const m={"á":128,"Á":128,"é":129,"É":129,"í":130,"Í":130,"ó":131,"Ó":131,"ú":132,"Ú":132,"ü":133,"Ü":133,"ñ":134,"Ñ":134,
   "¡":135,"¿":136,"♥":1,"◆":2,"▲":3,"✦":4,"°":137,"º":137,"à":65,"ä":65,"À":65,"è":69,"È":69,"ò":79,"Ò":79,"ç":67,"Ç":67};c=m[ch]!==undefined?m[ch]:63;}
  if(c!==32&&!FUENTE[c])c=63;out.push(c);}return out;}
function personalizar(s){return s.split("{N}").join(NOMBRE||t("HÉROE","HERO"));}
function columnasTexto(s){const cols=[];const cs=codigos(personalizar(s));
 cs.forEach((c,i)=>{if(c===32)cols.push(0,0,0);else FUENTE[c].forEach(v=>cols.push(v));if(i<cs.length-1)cols.push(0);});return cols;}
function sprite(cols,nombre,x,y,ancho){(SPR[nombre]||[]).forEach((v,i)=>{for(let f=0;f<16;f++)if(v>>f&1)pon(cols,x+i,y+f,ancho);});}
function pon(px,x,y,ancho){if(x>=0&&x<ancho&&y>=0&&y<8)px[x]|=1<<y;}
function pose(p){const px=new Array(32).fill(0);
 if(p==="1")sprite(px,"HEROE_TESORO",12,0,32);else if(p==="2")sprite(px,"HADA_A",13,1,32);else if(p==="3")sprite(px,"COFRE_ABIERTO",11,1,32);
 else if(p==="4")for(let k=0;k<4;k++)sprite(px,"CORAZON",k*8,1,32);
 else if(p==="5"){sprite(px,"TRIANGULO",12,0,32);sprite(px,"TRIANGULO",8,4,32);sprite(px,"TRIANGULO",16,4,32);}
 else if(p==="6")sprite(px,"BOMBA",12,0,32);
 else if(p==="s"){const c=FUENTE[63];c.forEach((v,i)=>px[14+i]=v);}
 return px;}
function pintar(cv,px,ancho){const g=cv.getContext("2d"),w=cv.width/ancho,h=cv.height/8;g.fillStyle="#070d09";g.fillRect(0,0,cv.width,cv.height);
 for(let x=0;x<ancho;x++)for(let y=0;y<8;y++){const on=px[x]>>y&1;g.fillStyle=on?"#ff5a2c":"#2a120c";
  if(on){g.shadowColor="#ff3b1f";g.shadowBlur=w*.6;}else g.shadowBlur=0;
  g.beginPath();g.arc(x*w+w/2,y*h+h/2,Math.min(w,h)*.38,0,7);g.fill();}g.shadowBlur=0;}

// Animación de la vista previa: pose del personaje y el texto pasando
let anim=null;
function vistaPrevia(){
 cancelAnimationFrame(anim);const cv=$("#vista");const txt=$("#texto").value.trim()||$("#texto").placeholder;
 const cols=columnasTexto(txt),p=est.pj;let fase=p==="0"?1:0,inicio=performance.now(),x=32;
 const paso=now=>{
  if(fase===0){pintar(cv,pose(p==="s"?"s":p),32);if(now-inicio>1100){fase=1;inicio=now;x=32;}}
  else{const desp=Math.floor((now-inicio)/est.vel);x=32-desp;const px=new Array(32).fill(0);
   for(let i=0;i<32;i++){const c=i-x;if(c>=0&&c<cols.length)px[i]=cols[c];}pintar(cv,px,32);
   if(x<-cols.length){fase=p==="0"?1:0;inicio=now;x=32;}}
  anim=requestAnimationFrame(paso);};
 anim=requestAnimationFrame(paso);
 const s=Math.round((cols.length+32)*est.vel/100)/10;
 $("#tiempo").textContent=t("Cada pasada tarda unos ","Each pass takes about ")+s+" s"+(est.dur?t(" · se repite durante "," · repeats for ")+etiquetaDur(est.dur):"");
}
function etiquetaDur(d){const x=DURACIONES.find(v=>v[0]==d);return x?t(x[1],x[2]):d+" s";}

// ---- Construir la página ----
function chips(cont,lista,valor,alElegir){const c=$(cont);c.innerHTML="";
 lista.forEach(([v,es,en])=>{const b=document.createElement("button");b.type="button";b.className="chip"+(String(v)===String(valor)?" sel":"");
  b.textContent=t(es,en);b.onclick=()=>{alElegir(v);c.querySelectorAll(".chip").forEach(e=>e.classList.remove("sel"));b.classList.add("sel");vistaPrevia();guardar();};c.appendChild(b);});}
function construir(){
 document.documentElement.lang=L;
 $("#titulo").textContent=NOMBRE?t("Mensaje para ","Message for ")+NOMBRE:t("Mensaje para el héroe","Message for the hero");
 $("#tMensaje").textContent=t("Tu mensaje","Your message");$("#tPersonaje").textContent=t("¿Quién lo trae?","Who brings it?");
 $("#tDuracion").textContent=t("¿Cuánto tiempo en pantalla?","How long on the display?");$("#tVelocidad").textContent=t("Velocidad","Speed");
 $("#consejo").textContent=t("Para quien está aprendiendo a leer: despacio y 1 minuto o más.","For early readers: slow, and 1 minute or more.");
 $("#enviar").textContent=t("Enviar al reloj ▲","Send to the clock ▲");$("#aAjustes").textContent=t("⚙️ Ajustes del reloj","⚙️ Clock settings");
 $("#bNombre").textContent=t("+ nombre","+ name");$("#texto").placeholder=RAPIDOS[L][0];
 const pc=$("#personajes");pc.innerHTML="";
 PERSONAJES.forEach(([v,es,en])=>{const b=document.createElement("button");b.type="button";b.className="pj"+(est.pj===v?" sel":"");
  const cv=document.createElement("canvas");cv.width=160;cv.height=40;
  if(v==="0"){const px=new Array(32).fill(0);columnasTexto("ABC").forEach((c,i)=>px[8+i]=c);pintar(cv,px,32);}else pintar(cv,pose(v),32);
  b.appendChild(cv);b.appendChild(document.createTextNode(t(es,en)));
  b.onclick=()=>{est.pj=v;$("#aventura").value="";pc.querySelectorAll(".pj").forEach(e=>e.classList.remove("sel"));b.classList.add("sel");vistaPrevia();guardar();};
  pc.appendChild(b);});
 chips("#duraciones",DURACIONES,est.dur,v=>est.dur=v);
 chips("#velocidades",VELOCIDADES,est.vel,v=>est.vel=v);
 rapidos();
 $("#tSonido").textContent=t("Sonido del aviso","Alert sound");$("#probarSonido").textContent=t("♪ Probar en el reloj","♪ Try it on the clock");
 $("#sinZumbador").textContent=t("El reloj no tiene zumbador activado (Ajustes del reloj → Sonido).","The clock has no buzzer turned on (Clock settings → Sound).");
 $("#tConc").textContent=t("Modo concentración","Focus mode");
 $("#concTexto").textContent=t("Solo la hora, quieta: sin segundos, sin fecha y sin aventuras.","Just the time, still: no seconds, no date, no adventures.");
 const cb=$("#concBotones");cb.innerHTML="";
 [[25,"25 min"],[45,"45 min"],[60,"1 h"],[120,"2 h"],[-1,t("Sin límite","No limit")],[0,t("Quitar","Turn off")]].forEach(([m,txt])=>{
  const b=document.createElement("button");b.type="button";b.className="chip"+(m===0?" quitar":"");b.textContent=txt;
  b.onclick=()=>fetch("/api/concentracion?minutos="+m,{method:"POST"}).then(()=>{mostrarAviso(m?t("🎓 Modo concentración puesto","🎓 Focus mode on"):t("Modo concentración quitado","Focus mode off"));setTimeout(estado,300);}).catch(()=>mostrarAviso(t("No llego al reloj 😕","Can't reach the clock 😕")));
  cb.appendChild(b);});
 fetch("/api/melodias").then(r=>r.json()).then(l=>{MELODIAS=l;sonidos();}).catch(()=>{});
 fetch("/api/aventuras").then(r=>r.json()).then(l=>{const s=$("#aventura");s.innerHTML="";
  const o=new Option(t("…o una aventura completa antes del mensaje","…or a full adventure before the message"),"");s.appendChild(o);
  l.forEach((n,i)=>s.appendChild(new Option("⚔️ "+n,"a"+i)));
  if(String(est.pj).startsWith("a")){s.value=est.pj;pc.querySelectorAll(".pj").forEach(e=>e.classList.remove("sel"));}}).catch(()=>{});
 vistaPrevia();
}
function sonidos(){
 const lista=[[0,t("🔇 Sin sonido","🔇 No sound"),t("🔇 Sin sonido","🔇 No sound")],...MELODIAS.map((n,i)=>[i+1,"♪ "+n,"♪ "+n])];
 if(est.son>MELODIAS.length)est.son=0;
 chips("#sonidos",lista,est.son,v=>est.son=v);
 $("#sinZumbador").style.display=HAY_SONIDO?"none":"block";}
$("#probarSonido").onclick=()=>{if(!est.son){mostrarAviso(t("Elige una melodía","Pick a tune"));return;}
 fetch("/api/sonido?melodia="+(est.son-1),{method:"POST"}).then(r=>mostrarAviso(r.ok?t("♪ Sonando en el reloj","♪ Playing on the clock"):t("Sin zumbador","No buzzer")));};
function rapidos(){const c=$("#rapidos");c.innerHTML="";
 const lista=[...est.recientes.filter(r=>!RAPIDOS[L].includes(r)).slice(0,5),...RAPIDOS[L]];
 lista.forEach(m=>{const b=document.createElement("button");b.type="button";b.className="chip";b.textContent=personalizar(m);
  b.onclick=()=>{$("#texto").value=m;contar();vistaPrevia();};c.appendChild(b);});}
$("#aventura").onchange=e=>{if(e.target.value){est.pj=e.target.value;document.querySelectorAll(".pj").forEach(x=>x.classList.remove("sel"));}
 else{est.pj="1";construir();}vistaPrevia();guardar();};
function contar(){$("#cuenta").textContent=$("#texto").value.length+"/200";}
$("#texto").oninput=()=>{contar();vistaPrevia();};
$("#texto").onkeydown=e=>{if(e.key==="Enter"){e.preventDefault();enviar();}};
$("#bNombre").onclick=()=>{const a=$("#texto");a.value=(a.value+" {N}").trim();contar();vistaPrevia();a.focus();};

function mostrarAviso(x){const a=$("#aviso");a.textContent=x;a.classList.add("ver");clearTimeout(a.t);a.t=setTimeout(()=>a.classList.remove("ver"),2600);}
function enviar(){
 const x=$("#texto").value.trim().toUpperCase();
 const paraReloj=x.replace(/♥/g,"\x01").replace(/◆/g,"\x02").replace(/▲/g,"\x03").replace(/✦/g,"\x04");
 if(!x){mostrarAviso(t("Escribe un mensaje","Type a message"));$("#texto").focus();return;}
 const datos=new URLSearchParams({texto:paraReloj,intro:est.pj,segundos:est.dur,velocidad:est.vel,sonido:HAY_SONIDO?est.son:0});
 fetch("/api/mensaje",{method:"POST",body:datos}).then(r=>{
  if(!r.ok)throw 0;mostrarAviso(t("¡Mensaje enviado! ▲","Message sent! ▲"));
  est.recientes=[x,...est.recientes.filter(m=>m!==x)].slice(0,5);guardar();rapidos();
  if(navigator.vibrate)navigator.vibrate(30);setTimeout(estado,600);
 }).catch(()=>mostrarAviso(t("No llego al reloj 😕","Can't reach the clock 😕")));
}
$("#enviar").onclick=enviar;
$("#parar").onclick=()=>fetch("/api/mensaje/parar",{method:"POST"}).then(()=>{mostrarAviso(t("Mensaje parado","Message stopped"));setTimeout(estado,400);});

function estado(){
 fetch("/api/estado",{cache:"no-store"}).then(r=>r.json()).then(e=>{
  conectado=true;$("#estado").className="ok";
  const cambia=(e.idioma==1?"en":"es")!==L||(e.nombre||"")!==NOMBRE;
  L=e.idioma==1?"en":"es";NOMBRE=e.nombre||"";if(cambia)construir();
  if(HAY_SONIDO!==!!e.sonido){HAY_SONIDO=!!e.sonido;sonidos();}
  $("#secConc").classList.toggle("activo",!!e.concentracion);
  $("#concEstado").textContent=e.concentracion?("🎓 "+t("Activo","On")+(e.concHorario?t(" (horario de estudio)"," (study schedule)"):"")+" · "+
   (e.concQueda<0?t("sin límite","no limit"):t("quedan ","")+Math.ceil(e.concQueda/60)+" min"+t(""," left"))):"";
  const p=$("#parar");
  if(e.mensajeActivo){p.classList.add("ver");
   p.textContent=e.mensajeQueda>0?"■ "+Math.floor(e.mensajeQueda/60)+":"+String(e.mensajeQueda%60).padStart(2,"0"):"■ "+t("Parar","Stop");
   $("#estadoTxt").textContent=t("En pantalla","On display");}
  else{p.classList.remove("ver");$("#estadoTxt").textContent=e.hora?e.hora.slice(0,5):t("Conectado","Connected");}
 }).catch(()=>{conectado=false;$("#estado").className="";$("#estadoTxt").textContent=t("Sin conexión","Offline");});
}
construir();contar();estado();setInterval(estado,2000);
</script>
</body></html>
)PAGINA";

const char MANIFIESTO[] PROGMEM = R"JSON({"name": "Reloj de Hyrule", "short_name": "Hyrule", "start_url": "/mensaje", "display": "standalone", "background_color": "#0f2418", "theme_color": "#0f2418", "icons": [{"src": "/icono.png", "sizes": "180x180", "type": "image/png"}]})JSON";

// Icono para la pantalla de inicio (PNG 180 x 180, 4943 bytes)
const uint8_t ICONO_PNG[] PROGMEM = {
  0x89, 0x50, 0x4E, 0x47, 0x0D, 0x0A, 0x1A, 0x0A, 0x00, 0x00, 0x00, 0x0D, 0x49, 0x48, 0x44, 0x52, 0x00, 0x00, 0x00, 0xB4,
  0x00, 0x00, 0x00, 0xB4, 0x08, 0x03, 0x00, 0x00, 0x00, 0x0A, 0x13, 0xF6, 0x00, 0x00, 0x00, 0x00, 0xC0, 0x50, 0x4C, 0x54,
  0x45, 0xFF, 0xF4, 0x54, 0xFF, 0xF2, 0x54, 0xFF, 0xEF, 0x53, 0xFF, 0xEB, 0x52, 0xFF, 0xE7, 0x51, 0xFF, 0xE2, 0x50, 0xFF,
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  0x42, 0x60, 0x82
};
